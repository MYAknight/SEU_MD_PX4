## src/modules/external_force_estimator/Kconfig
```kconfig
menuconfig MODULES_EXTERNAL_FORCE_ESTIMATOR
	bool "external_force_estimator"
	default n
	---help---
		Enable selection of external_force_estimator
```

## src/modules/huaqiccc_morph_control/Kconfig
```kconfig
menuconfig MODULES_HUAQICCC_MORPH_CONTROL
	bool "huaqiccc morphing arm control"
	default n
	---help---
		Control a single linear actuator (PWM servo on AUX1) with
		AS5600 magnetic encoder feedback (I2C). Simple P-control
		with deadband. Publishes huaqiccc_morph_angle for
		ControlAllocator LUT updates.
```
